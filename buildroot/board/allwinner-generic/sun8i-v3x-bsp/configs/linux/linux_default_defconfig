## buildroot/boot/opensbi-d1/Config.in
```kconfig
config BR2_TARGET_OPENSBI_D1
	bool "opensbi for allwinner d1"
	depends on BR2_riscv
	help
	  OpenSBI aims to provide an open-source and extensible
	  implementation of the RISC-V SBI specification for a platform
	  specific firmware (M-mode) and a general purpose OS,
	  hypervisor or bootloader (S-mode or HS-mode). OpenSBI
	  implementation can be easily extended by RISC-V platform or
	  System-on-Chip vendors to fit a particular hadware
	  configuration.

	  https://github.com/Tina-Linux/OpenSBI-C906.git

if BR2_TARGET_OPENSBI_D1
choice
	prompt "OpenSBI Version"
	help
	  Select the specific OpenSBI version you want to use

config BR2_TARGET_OPENSBI_D1_LATEST_VERSION
	bool "0.6"

endchoice

config BR2_TARGET_OPENSBI_D1_CUSTOM_VERSION_VALUE
	string "OpenSBI version"
	depends on BR2_TARGET_OPENSBI_D1_CUSTOM_VERSION

config BR2_TARGET_OPENSBI_D1_PLAT
	string "OpenSBI Platform"
	default "thead/c910"
	help
	  Specifies the OpenSBI platform to build. If no platform is
	  specified only the OpenSBI platform independent static
	  library libsbi.a is built. If a platform is specified then
	  the platform specific static library libplatsbi.a and firmware
	  examples are built.

config BR2_TARGET_OPENSBI_D1_INSTALL_DYNAMIC_IMG
	bool "Install fw_dynamic image"
	default y if BR2_TARGET_OPENSBI_D1_PLAT != ""
	help
	  This installs the fw_dynamic image.

config BR2_TARGET_OPENSBI_D1_INSTALL_JUMP_IMG
	bool "Install fw_jump image"
	default y if BR2_TARGET_OPENSBI_D1_PLAT != ""
	help
	  This installs the fw_jump image.

endif
```

## buildroot/configs/Sipeed_lichee_zero_defconfig
```kconfig
BR2_arm=y
BR2_cortex_a7=y
BR2_ARM_FPU_VFPV4=y
BR2_TOOLCHAIN_BUILDROOT_GLIBC=y
BR2_PACKAGE_HOST_LINUX_HEADERS_CUSTOM_5_4=y
BR2_GCC_VERSION_9_X=y
BR2_TARGET_GENERIC_HOSTNAME="lichee"
BR2_TARGET_GENERIC_ISSUE="Welcome to LicheePi Zero"
BR2_TARGET_GENERIC_GETTY_PORT="ttyS0"
BR2_TARGET_GENERIC_GETTY_BAUDRATE_115200=y
BR2_ROOTFS_POST_IMAGE_SCRIPT="board/allwinner-generic/sun8i-generic/scripts/genimage.sh"
BR2_ROOTFS_POST_SCRIPT_ARGS="-c board/licheepi/genimage.cfg"
BR2_LINUX_KERNEL=y
BR2_LINUX_KERNEL_CUSTOM_VERSION=y
BR2_LINUX_KERNEL_CUSTOM_VERSION_VALUE="5.4.180"
BR2_LINUX_KERNEL_USE_CUSTOM_CONFIG=y
BR2_LINUX_KERNEL_CUSTOM_CONFIG_FILE="board/Sipeed/lichee-zero/config/linux.defconfig"
BR2_LINUX_KERNEL_DTS_SUPPORT=y
BR2_LINUX_KERNEL_CUSTOM_DTS_PATH="board/allwinner-generic/sun8i-v3s/dts/sun8i-v3s-linux.dtsi board/Sipeed/lichee-zero/dts/sun8i-v3s-licheepi-zero-linux.dts"
BR2_PACKAGE_LINUX_FIRMWARE=y
BR2_PACKAGE_LINUX_FIRMWARE_RTL_87XX=y
BR2_PACKAGE_WPA_SUPPLICANT=y
BR2_PACKAGE_WPA_SUPPLICANT_AUTOSCAN=y
BR2_TARGET_ROOTFS_EXT2=y
BR2_TARGET_ROOTFS_EXT2_4=y
BR2_TARGET_UBOOT=y
BR2_TARGET_UBOOT_BUILD_SYSTEM_KCONFIG=y
BR2_TARGET_UBOOT_CUSTOM_VERSION=y
BR2_TARGET_UBOOT_CUSTOM_VERSION_VALUE="2020.07"
BR2_TARGET_UBOOT_PATCH="board/Sipeed/lichee-zero/patch/uboot"
BR2_TARGET_UBOOT_USE_CUSTOM_CONFIG=y
BR2_TARGET_UBOOT_CUSTOM_CONFIG_FILE="board/Sipeed/lichee-zero/config/uboot.defconfig"
BR2_TARGET_UBOOT_NEEDS_DTC=y
BR2_TARGET_UBOOT_NEEDS_PYLIBFDT=y
BR2_TARGET_UBOOT_FORMAT_CUSTOM=y
BR2_TARGET_UBOOT_FORMAT_CUSTOM_NAME="u-boot-sunxi-with-spl.bin"
BR2_TARGET_UBOOT_CUSTOM_DTS_PATH="board/allwinner-generic/sun8i-v3s/dts/sun8i-v3s-uboot.dtsi board/Sipeed/lichee-zero/dts/sun8i-v3s-licheepi-zero-uboot.dts"
BR2_PACKAGE_HOST_DOSFSTOOLS=y
BR2_PACKAGE_HOST_GENIMAGE=y
BR2_PACKAGE_HOST_MTOOLS=y
BR2_PACKAGE_HOST_UBOOT_TOOLS=y
BR2_PACKAGE_HOST_UBOOT_TOOLS_BOOT_SCRIPT=y
BR2_PACKAGE_HOST_UBOOT_TOOLS_BOOT_SCRIPT_SOURCE="board/allwinner-generic/sun8i-v3s/script/bootcmd"
```

## buildroot/configs/YuzukiHD_YuzukiRuler_defconfig
```kconfig
BR2_arm=y
BR2_TOOLCHAIN_BUILDROOT_MUSL=y
BR2_PACKAGE_HOST_LINUX_HEADERS_CUSTOM_5_4=y
BR2_TOOLCHAIN_BUILDROOT_CXX=y
BR2_GCC_ENABLE_LTO=y
BR2_PACKAGE_HOST_GDB=y
BR2_PACKAGE_HOST_GDB_TUI=y
BR2_PACKAGE_HOST_GDB_PYTHON=y
BR2_PACKAGE_HOST_GDB_SIM=y
BR2_TARGET_GENERIC_HOSTNAME="YuzukiRuler"
BR2_TARGET_GENERIC_ISSUE="Welcome to Yuzuki Ruler"
BR2_ROOTFS_DEVICE_CREATION_DYNAMIC_EUDEV=y
BR2_ROOTFS_OVERLAY="board/allwinner/generic/rootfs board/allwinner/suniv-f1c100s/rootfs board/YuzukiHD/YuzukiRuler/rootfs"
BR2_ROOTFS_POST_IMAGE_SCRIPT="board/allwinner/generic/scripts/genimage.sh"
BR2_ROOTFS_POST_SCRIPT_ARGS="${BR2_TARGET_UBOOT_SPL_NAME}"
BR2_LINUX_KERNEL=y
BR2_LINUX_KERNEL_CUSTOM_GIT=y
BR2_LINUX_KERNEL_CUSTOM_REPO_URL="https://github.com/YuzukiHD/linux-5.4.99"
BR2_LINUX_KERNEL_CUSTOM_REPO_VERSION="0.0.1"
BR2_LINUX_KERNEL_PATCH="board/YuzukiHD/YuzukiRuler/patch/linux"
BR2_LINUX_KERNEL_USE_CUSTOM_CONFIG=y
BR2_LINUX_KERNEL_CUSTOM_CONFIG_FILE="board/YuzukiHD/YuzukiRuler/config/linux/linux.defconfig"
BR2_LINUX_KERNEL_DTS_SUPPORT=y
BR2_LINUX_KERNEL_CUSTOM_DTS_PATH="board/allwinner/suniv-f1c100s/devicetree/linux/suniv-f1c100s.dtsi board/YuzukiHD/YuzukiRuler/devicetree/linux/devicetree.dts"
BR2_PACKAGE_GDB=y
BR2_PACKAGE_FSWEBCAM=y
BR2_PACKAGE_FB_TEST_APP=y
BR2_PACKAGE_UMTPRD=y
BR2_PACKAGE_TINYALSA=y
BR2_PACKAGE_LIBV4L=y
BR2_PACKAGE_LIBV4L_UTILS=y
BR2_PACKAGE_TSLIB=y
BR2_PACKAGE_READLINE=y
BR2_PACKAGE_HAVEGED=y
BR2_PACKAGE_ZSH=y
BR2_PACKAGE_UTIL_LINUX_UUIDD=y
BR2_TARGET_ROOTFS_CPIO=y
BR2_TARGET_ROOTFS_CPIO_GZIP=y
BR2_TARGET_ROOTFS_EXT2=y
BR2_TARGET_ROOTFS_EXT2_4=y
BR2_TARGET_ROOTFS_EXT2_SIZE="100M"
BR2_TARGET_ROOTFS_SQUASHFS=y
BR2_TARGET_UBOOT=y
BR2_TARGET_UBOOT_BUILD_SYSTEM_KCONFIG=y
BR2_TARGET_UBOOT_CUSTOM_VERSION=y
BR2_TARGET_UBOOT_CUSTOM_VERSION_VALUE="2020.07"
BR2_TARGET_UBOOT_PATCH="board/allwinner/suniv-f1c100s/patch/u-boot"
BR2_TARGET_UBOOT_USE_CUSTOM_CONFIG=y
BR2_TARGET_UBOOT_CUSTOM_CONFIG_FILE="board/YuzukiHD/YuzukiRuler/config/uboot/uboot.defconfig"
BR2_TARGET_UBOOT_NEEDS_DTC=y
BR2_TARGET_UBOOT_SPL=y
BR2_TARGET_UBOOT_SPL_NAME="u-boot-sunxi-with-spl.bin"
BR2_TARGET_UBOOT_CUSTOM_DTS_PATH="board/allwinner/suniv-f1c100s/devicetree/uboot/suniv-f1c100s.dtsi board/YuzukiHD/YuzukiRuler/devicetree/uboot/suniv-f1c100s-generic.dts"
BR2_PACKAGE_HOST_DOSFSTOOLS=y
BR2_PACKAGE_HOST_GENIMAGE=y
BR2_PACKAGE_HOST_MTOOLS=y
BR2_PACKAGE_HOST_PYTHON3=y
BR2_PACKAGE_HOST_PYTHON3_SSL=y
BR2_PACKAGE_HOST_UBOOT_TOOLS=y
BR2_PACKAGE_HOST_UBOOT_TOOLS_FIT_SUPPORT=y
BR2_PACKAGE_HOST_UBOOT_TOOLS_FIT_SIGNATURE_SUPPORT=y
```

## buildroot/configs/aw-ol_nezha_defconfig
```kconfig
BR2_riscv=y
BR2_GLOBAL_PATCH_DIR="board/allwinner-generic/sun20i-d1/patch"
BR2_PACKAGE_HOST_LINUX_HEADERS_CUSTOM_5_14=y
BR2_ROOTFS_OVERLAY="board/aw-ol/nezha/overlay"
BR2_ROOTFS_POST_IMAGE_SCRIPT="support/scripts/genimage.sh"
BR2_ROOTFS_POST_SCRIPT_ARGS="-c board/allwinner-generic/sun20i-d1/genimage.cfg"
BR2_LINUX_KERNEL=y
BR2_LINUX_KERNEL_CUSTOM_VERSION=y
BR2_LINUX_KERNEL_CUSTOM_VERSION_VALUE="5.4.61"
BR2_LINUX_KERNEL_PATCH="board/allwinner-generic/sun20i-d1/patch/linux"
BR2_LINUX_KERNEL_DEFCONFIG="nezha"
BR2_LINUX_KERNEL_DTS_SUPPORT=y
BR2_LINUX_KERNEL_INTREE_DTS_NAME="allwinner/sun20i-d1-nezha"
BR2_LINUX_KERNEL_INSTALL_TARGET=y
BR2_TARGET_ROOTFS_EXT2=y
BR2_TARGET_ROOTFS_EXT2_4=y
# BR2_TARGET_ROOTFS_TAR is not set
BR2_TARGET_OPENSBI=y
BR2_TARGET_OPENSBI_CUSTOM_TARBALL=y
BR2_TARGET_OPENSBI_CUSTOM_TARBALL_LOCATION="$(call github,smaeul,opensbi,b9125c6f8909d1cc0417795737fc13cb6297ff11)/opensbi-b9125c6f8909d1cc0417795737fc13cb6297ff11.tar.gz"
BR2_TARGET_OPENSBI_PLAT="generic"
# BR2_TARGET_OPENSBI_INSTALL_JUMP_IMG is not set
BR2_TARGET_SUN20I_D1_SPL=y
BR2_TARGET_UBOOT=y
BR2_TARGET_UBOOT_BUILD_SYSTEM_KCONFIG=y
BR2_TARGET_UBOOT_CUSTOM_TARBALL=y
BR2_TARGET_UBOOT_CUSTOM_TARBALL_LOCATION="$(call github,smaeul,u-boot,62392d3b8a624a80646c1876533336f90140088d)/uboot-62392d3b8a624a80646c1876533336f90140088d.tar.gz"
BR2_TARGET_UBOOT_BOARD_DEFCONFIG="nezha"
BR2_TARGET_UBOOT_NEEDS_DTC=y
BR2_TARGET_UBOOT_NEEDS_PYLIBFDT=y
BR2_TARGET_UBOOT_NEEDS_OPENSSL=y
BR2_TARGET_UBOOT_NEEDS_OPENSBI=y
# BR2_TARGET_UBOOT_FORMAT_BIN is not set
BR2_TARGET_UBOOT_FORMAT_CUSTOM=y
BR2_TARGET_UBOOT_FORMAT_CUSTOM_NAME="u-boot.toc1"
BR2_PACKAGE_HOST_GENIMAGE=y
```
